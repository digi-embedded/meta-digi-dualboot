## conf/layer.conf
```bitbake
# We have a conf and classes directory, add to BBPATH
BBPATH .= ":${LAYERDIR}"

# We have recipes-* directories, add to BBFILES
BBFILES += "${LAYERDIR}/recipes-*/*/*.bb \
	${LAYERDIR}/recipes-*/*/*.bbappend"

BBFILE_COLLECTIONS += "digi-dualboot"
BBFILE_PATTERN_digi-dualboot = "^${LAYERDIR}/"
BBFILE_PRIORITY_digi-dualboot = "6"

LAYERDEPENDS_digi-dualboot = "digi-arm digi-dey"
LAYERSERIES_COMPAT_digi-dualboot = "gatesgarth"
```
